## conf/machine/imx6q-imsse01.conf
```bitbake
#@TYPE: Machine
#@NAME: Advantech IMS-SE01
#@SOC: i.MX6Q
#@DESCRIPTION: Machine configuration for Advantech IMS-SE01 board

include conf/machine/include/imx-base.inc
include conf/machine/include/tune-cortexa9.inc

SOC_FAMILY = "mx6:mx6q"

SERIAL_CONSOLE = "115200 ttymxc0"

PREFERRED_PROVIDER_virtual/bootloader = "u-boot-imx"
PREFERRED_PROVIDER_u-boot = "u-boot-imx"
UBOOT_MACHINE = "mx6qimsse01_defconfig"

PREFERRED_PROVIDER_virtual/kernel = "linux-imx"
PREFERRED_PROVIDER_kernel = "linux-imx"
KERNEL_DEVICETREE = "imx6q-imsse01.dtb"

MACHINE_FEATURES += "pci"
```
